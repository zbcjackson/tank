## device/sdkconfig.defaults
```kconfig
# CPU
CONFIG_ESP32S3_DEFAULT_CPU_FREQ_240=y

# Flash — 16MB for CoreS3
CONFIG_ESPTOOLPY_FLASHSIZE_16MB=y
CONFIG_ESPTOOLPY_FLASHSIZE="16MB"
CONFIG_PARTITION_TABLE_CUSTOM=y
CONFIG_PARTITION_TABLE_CUSTOM_FILENAME="partitions_16MB.csv"

# PSRAM
CONFIG_SPIRAM=y
CONFIG_SPIRAM_MODE_QUAD=y
CONFIG_SPIRAM_SPEED_80M=y
CONFIG_SPIRAM_USE_CAPS_ALLOC=y
# Move WiFi/LWIP buffers to PSRAM to free internal DRAM. In wake-word mode
# esp-sr/WakeNet consumes enough internal RAM that the WebSocket task's
# xTaskCreate failed ("Error create websocket task"), leaving the UI stuck on
# "Connecting to Tank". This is a targeted move (WiFi/LWIP only) that keeps the
# caps-based allocator so DMA descriptors (I2S audio, LCD) stay in internal RAM.
CONFIG_SPIRAM_TRY_ALLOCATE_WIFI_LWIP=y

# I2S
CONFIG_I2S_ISR_IRAM_SAFE=y

# WiFi pinned to core 1 (core 0 for audio)
CONFIG_ESP_WIFI_TASK_PINNED_TO_CORE_1=y

# FreeRTOS — 1ms tick for 20ms audio granularity
CONFIG_FREERTOS_HZ=1000

# Network buffers
CONFIG_LWIP_TCP_SND_BUF_DEFAULT=65535
CONFIG_LWIP_TCP_RECVMBOX_SIZE=16

# Main task
CONFIG_ESP_MAIN_TASK_STACK_SIZE=8192

# Console output via USB Serial/JTAG (CoreS3 native USB port)
CONFIG_ESP_CONSOLE_USB_SERIAL_JTAG=y

# LVGL fonts — enable larger Montserrat sizes for a readable device UI.
# (LVGL on ESP-IDF uses Kconfig, not lv_conf.h — CONFIG_LV_CONF_SKIP is set.)
CONFIG_LV_FONT_MONTSERRAT_16=y
CONFIG_LV_FONT_MONTSERRAT_18=y
CONFIG_LV_FONT_MONTSERRAT_20=y
CONFIG_LV_FONT_MONTSERRAT_24=y
CONFIG_LV_FONT_MONTSERRAT_28=y
CONFIG_LV_FONT_DEFAULT_MONTSERRAT_18=y

# esp-sr wake word — WakeNet9, stock "Hi ESP", loaded from the `model` partition.
# Force MultiNet (command recognition) OFF so only the WakeNet model is flashed,
# keeping the partition small (~0.5MB). Without these explicit NONEs esp-sr packs
# a ~3.4MB Chinese MultiNet model that overflows the model partition.
CONFIG_MODEL_IN_FLASH=y
CONFIG_SR_WN_WN9_HIESP=y
CONFIG_SR_MN_CN_NONE=y
CONFIG_SR_MN_EN_NONE=y
```
